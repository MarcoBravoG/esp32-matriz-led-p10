/*
  ============================================================
   HOLA MUNDO en matriz LED P10 (32x16) con ESP32 - SIN LIBRERIAS
  ============================================================
   CONEXION (conector HUB12 de ENTRADA del P10 -> ESP32)
     OE  -> GPIO 22     A   -> GPIO 19     B -> GPIO 21
     CLK -> GPIO 18     LAT -> GPIO 2      R -> GPIO 23
     GND -> GND (unido tambien al GND de la fuente de 5V)
  ============================================================
   1) Muestra "Hola" / "Mundo" fijo durante 3 segundos
   2) Desplaza "Hola Mundo" en letra grande
  ============================================================
*/

#define OE  22
#define A   19
#define B   21
#define CLK 18
#define LAT 2
#define R   23

const char *MENSAJE = "Hola Mundo";
const int VELOCIDAD = 40;      // ms por paso (menor = mas rapido)
const int TIEMPO_FIJO = 3000;  // ms del texto fijo
const int BRILLO_US = 800;     // tiempo por fila en microsegundos

// Memoria de pantalla: 16 filas x 4 bytes (32 pixeles). Bit 1 = LED encendido
uint8_t pantalla[16][4];

// Fuente 5x7 (ASCII 32 a 126), cada byte es una columna, bit 0 = arriba
const uint8_t fuente[95][5] = {
  {0x00,0x00,0x00,0x00,0x00},{0x00,0x00,0x5F,0x00,0x00},{0x00,0x07,0x00,0x07,0x00},{0x14,0x7F,0x14,0x7F,0x14},
  {0x24,0x2A,0x7F,0x2A,0x12},{0x23,0x13,0x08,0x64,0x62},{0x36,0x49,0x55,0x22,0x50},{0x00,0x05,0x03,0x00,0x00},
  {0x00,0x1C,0x22,0x41,0x00},{0x00,0x41,0x22,0x1C,0x00},{0x08,0x2A,0x1C,0x2A,0x08},{0x08,0x08,0x3E,0x08,0x08},
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  {0x00,0x00,0x7F,0x00,0x00},{0x00,0x41,0x36,0x08,0x00},{0x08,0x08,0x2A,0x1C,0x08}
};

// ---------------- Dibujo en memoria ----------------
void limpiar() {
  memset(pantalla, 0, sizeof(pantalla));
}

void pixel(int x, int y) {
  if (x < 0 || x > 31 || y < 0 || y > 15) return;
  pantalla[y][x / 8] |= (0x80 >> (x % 8));
}

// Dibuja una letra; escala 1 = 5x7, escala 2 = 10x14. Devuelve el ancho usado
int letra(int x, int y, char c, int escala) {
  if (c < 32 || c > 126) c = '?';
  for (int col = 0; col < 5; col++) {
    uint8_t datos = fuente[c - 32][col];
    for (int fil = 0; fil < 7; fil++) {
      if (datos & (1 << fil)) {
        for (int dx = 0; dx < escala; dx++)
          for (int dy = 0; dy < escala; dy++)
            pixel(x + col * escala + dx, y + fil * escala + dy);
      }
    }
  }
  return 6 * escala;
}

void texto(int x, int y, const char *s, int escala) {
  while (*s) x += letra(x, y, *s++, escala);
}

int anchoTexto(const char *s, int escala) {
  return strlen(s) * 6 * escala;
}

// ---------------- Envio al panel ----------------
void enviarByte(uint8_t b) {
  for (int i = 7; i >= 0; i--) {
    digitalWrite(R, ((b >> i) & 1) ? LOW : HIGH);  // en el P10: LOW = encendido
    digitalWrite(CLK, HIGH);
    digitalWrite(CLK, LOW);
  }
}

// El P10 es de 1/4 de barrido: cada fase enciende las filas s, s+4, s+8 y s+12
void refrescar() {
  for (int s = 0; s < 4; s++) {
    for (int i = 0; i < 4; i++) {
      enviarByte(pantalla[s + 12][i]);
      enviarByte(pantalla[s + 8][i]);
      enviarByte(pantalla[s + 4][i]);
      enviarByte(pantalla[s][i]);
    }
    digitalWrite(OE, LOW);
    digitalWrite(LAT, HIGH);
    digitalWrite(LAT, LOW);
    digitalWrite(A, s & 1);
    digitalWrite(B, (s >> 1) & 1);
    digitalWrite(OE, HIGH);
    delayMicroseconds(BRILLO_US);
  }
  digitalWrite(OE, LOW);  // evita que la ultima fila brille mas
}

// ---------------- Programa principal ----------------
int modo = 0;             // 0 = fijo, 1 = desplazamiento
int xScroll = 32;
unsigned long tModo = 0, tPaso = 0;

void mostrarFijo() {
  limpiar();
  texto(4, 0, "Hola", 1);
  texto(1, 8, "Mundo", 1);
}

void setup() {
  int pines[] = {OE, A, B, CLK, LAT, R};
  for (int p : pines) pinMode(p, OUTPUT);
  digitalWrite(OE, LOW);
  Serial.begin(115200);
  Serial.println("P10 sin libreria listo");
  mostrarFijo();
  tModo = millis();
}

void loop() {
  refrescar();
  unsigned long ahora = millis();

  if (modo == 0) {
    if (ahora - tModo > TIEMPO_FIJO) {
      modo = 1;
      xScroll = 32;
      tPaso = ahora;
    }
  } else {
    if (ahora - tPaso > VELOCIDAD) {
      tPaso = ahora;
      xScroll--;
      limpiar();
      texto(xScroll, 1, MENSAJE, 2);
      if (xScroll < -anchoTexto(MENSAJE, 2)) {
        modo = 0;
        mostrarFijo();
        tModo = ahora;
      }
    }
  }
}